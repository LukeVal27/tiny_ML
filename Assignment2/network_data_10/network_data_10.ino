// EE446 TinyML - Assignment 2, Question 5(d)
// Luke Valerio
// 10 test samples (X_test rows 5..14) from the seeded split (random_state=42).

#include <TensorFlowLite.h>
#include "network_model.h"
#include "tensorflow/lite/micro/kernels/micro_ops.h"
#include "tensorflow/lite/micro/micro_error_reporter.h"
#include "tensorflow/lite/micro/micro_interpreter.h"
#include "tensorflow/lite/micro/micro_mutable_op_resolver.h"
#include "tensorflow/lite/schema/schema_generated.h"
#include "tensorflow/lite/version.h"
#include <math.h>

#define NUMBER_OF_INPUTS 38
#define NUMBER_OF_OUTPUTS 1
#define TENSOR_ARENA_SIZE (32 * 1024)

uint8_t tensor_arena[TENSOR_ARENA_SIZE];
tflite::ErrorReporter* error_reporter;
tflite::MicroInterpreter* interpreter;
TfLiteTensor* input;
TfLiteTensor* output;

const float X_test[10][38] = {
    -0.11024922321249885, -0.12470615670462065, 1.0873051789289023, 
    -2.2235805674567635, -0.00776224074056876, -0.004918644383724874, 
    -0.08948642202040107, -0.09507567152556495, -0.8092618187059747, 
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    -0.3763870260680415, -0.6563667617603728
};



const uint8_t y_test[10] = {
    0, 1, 0, 1, 0, 0, 0, 1, 0, 1
};  // Actual labels for each sample

int8_t quantize_to_int8(float value, float scale, int zero_point) {
    int32_t quantized_value =
        static_cast<int32_t>(lroundf(value / scale)) + zero_point;

    if (quantized_value > 127) {
        quantized_value = 127;
    }

    if (quantized_value < -128) {
        quantized_value = -128;
    }

    return static_cast<int8_t>(quantized_value);
}

void setup() {
    Serial.begin(115200);
    static tflite::MicroErrorReporter micro_error_reporter;
    error_reporter = &micro_error_reporter;

    const tflite::Model* model = tflite::GetModel(network_model);
    if (model->version() != TFLITE_SCHEMA_VERSION) {
        Serial.println("Model version does not match schema version.");
        return;
    }

    static tflite::MicroMutableOpResolver<10> micro_op_resolver;
    micro_op_resolver.AddFullyConnected();
    micro_op_resolver.AddLogistic();
    micro_op_resolver.AddQuantize();
    micro_op_resolver.AddDequantize();

    static tflite::MicroInterpreter static_interpreter(model, micro_op_resolver, tensor_arena, TENSOR_ARENA_SIZE, error_reporter);
    interpreter = &static_interpreter;

    if (interpreter->AllocateTensors() != kTfLiteOk) {
        Serial.println("Failed to allocate tensors!");
        return;
    }

    input = interpreter->input(0);
    output = interpreter->output(0);

    if (input->type != kTfLiteInt8 || output->type != kTfLiteInt8) {
        Serial.println("Expected INT8 input and output tensors.");
        return;
    }
}

void loop() {
    for (uint8_t i = 0; i < 10; i++) {
        // Load the i-th test sample data into the input tensor
        for (int j = 0; j < NUMBER_OF_INPUTS; j++) {
           input->data.int8[j] = quantize_to_int8(
            X_test[i][j],
            input->params.scale,
            input->params.zero_point
            );
        }

        // Run the model on this input and check for error
        if (interpreter->Invoke() != kTfLiteOk) {
            Serial.println("Failed to invoke!");
            continue;
        }

        // Question 5: Deploying the Quantized Model
        // (a) Implement code to obtain the sigmoid prediction from the INT8
        // output tensor and determine the predicted class label.
        // The output tensor is INT8, so it must be dequantized back to a float
        // probability using the output tensor's own scale and zero point:
        //     real_value = (quantized_value - zero_point) * scale
        // The result is the sigmoid output in [0, 1]; thresholding at 0.5 gives
        // the class (1 = normal, 0 = attack).
        float prediction = (output->data.int8[0] - output->params.zero_point) * output->params.scale;
        int predicted_class = (prediction > 0.5f) ? 1 : 0;

        // (b) Implement code to output Sample #, Predicted Class, and Actual Class for each sample to the serial monitor using Serial.print function.
        Serial.print("Sample #");
        Serial.print(i);
        Serial.print("  |  Predicted Class: ");
        Serial.print(predicted_class);
        Serial.print("  |  Actual Class: ");
        Serial.print(y_test[i]);
        Serial.print("  |  (sigmoid = ");
        Serial.print(prediction, 4);
        Serial.println(")");


        // Delay between predictions
        delay(1000);
    }

    // Delay before repeating the tests
    delay(10000);
}
